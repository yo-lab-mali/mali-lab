/*
 * Research DT fragment based on the Arm virtual-platform example.
 * This does not make stock QEMU emulate Mali hardware.
 */
gpu: gpu@6e000000 {
        compatible = "arm,mali-midgard";
        reg = <0x0 0x6e000000 0x0 0x200000>;
        interrupts = <0 168 4>,
                     <0 168 4>,
                     <0 168 4>;
        interrupt-names = "JOB", "MMU", "GPU";
};
